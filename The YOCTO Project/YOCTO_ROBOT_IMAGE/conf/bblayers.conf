## The YOCTO Project/YOCTO_ROBOT_IMAGE/conf/bblayers.conf
```bitbake
# POKY_BBLAYERS_CONF_VERSION is increased each time build/conf/bblayers.conf
# changes incompatibly
POKY_BBLAYERS_CONF_VERSION = "2"

BBPATH = "${TOPDIR}"
BBFILES ?= ""

BBLAYERS ?= " \
  /home/nour/Nour/YOCTO/poky/meta \
  /home/nour/Nour/YOCTO/poky/meta-poky \
  /home/nour/Nour/YOCTO/poky/meta-yocto-bsp \
  /home/nour/Nour/YOCTO/poky/meta-raspberrypi \
  /home/nour/Nour/YOCTO/poky/meta-openembedded/meta-oe \
  /home/nour/Nour/YOCTO/poky/meta-openembedded/meta-gnome \
  /home/nour/Nour/YOCTO/poky/meta-openembedded/meta-xfce \
  /home/nour/Nour/YOCTO/poky/meta-openembedded/meta-python \
  /home/nour/Nour/YOCTO/poky/meta-openembedded/meta-networking \
  /home/nour/Nour/YOCTO/poky/meta-openembedded/meta-multimedia \
  /home/nour/Nour/YOCTO/poky/meta-qt5 \
  "
```
